## firmware/build/Kconfig/boards/Kconfig.nrf54l15dk
```kconfig
# Load board Kconfig descriptions.
osource "C:/ncs/zephyr/boards/nordic/nrf54l15dk/Kconfig.nrf54l15dk"
```

## firmware/build/firmware/Kconfig/boards/Kconfig.defconfig
```kconfig
# Load Zephyr board defconfig descriptions.
osource "C:/ncs/zephyr/boards/nordic/nrf54l15dk/Kconfig.defconfig"
```

## firmware/build/firmware/Kconfig/boards/Kconfig.sysbuild
```kconfig
# Load Sysbuild board Kconfig descriptions.
osource "C:/ncs/zephyr/boards/nordic/nrf54l15dk/Kconfig.sysbuild"
```
